## Kconfig
```kconfig
menu "Battery Monitor Module"

config ZMK_BATTERY_MONITOR
    bool "Enable Battery Monitor Module"
    default y
    depends on ZMK
    help
      Enable the ZMK Battery Monitor module.

      This module integrates battery state reporting into ZMK.
      It does NOT perform voltage measurement directly, but retrieves
      data from an external Non-LiPo Battery Management module
      (e.g. sekigon-gonnoc/zmk-feature-non-lipo-battery-management).

config ZMK_BATTERY_MONITOR_PERIOD
    int "Battery monitor update interval (seconds)"
    default 30
    depends on ZMK_BATTERY_MONITOR
    help
      How often to update battery state (forwarded from external manager).

endmenu
```

## dts/bindings/zmk,battery-monitor.yaml
```yaml
description: ZMK Battery Monitor device

compatible: "zmk,battery-monitor"

include: base.yaml

properties:
  manager:
    type: phandle
    required: true
    description: |
      Reference to the battery management device (e.g. non-lipo manager).
      Used to retrieve voltage and charge state.

  full-mv:
    type: int
    required: false
    description: |
      Optional full-scale voltage in millivolts (for user info).

  empty-mv:
    type: int
    required: false
    description: |
      Optional empty voltage in millivolts (for user info).

  status:
    type: string
    required: false
    description: |
      Standard Zephyr device status property.
```
